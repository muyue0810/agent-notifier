## sdkconfig.defaults
```kconfig
CONFIG_IDF_TARGET="esp32s3"

# 出错时停止打印，方便看日志（调试期）
CONFIG_ESP_SYSTEM_PANIC_PRINT_HALT=y

# 日志从 USB-serial-jtag 输出（下载/调试口，与 CDC 应用切换共用 USB 外设）
CONFIG_ESP_CONSOLE_USB_SERIAL_JTAG=y

# 性能：Cache 配置
CONFIG_ESP32S3_DATA_CACHE_64KB=y
CONFIG_ESP32S3_DATA_CACHE_LINE_64B=y
CONFIG_ESP32S3_INSTRUCTION_CACHE_32KB=y

# PSRAM（老款 BOX 用 Octal PSRAM）
CONFIG_ESP32S3_SPIRAM_SUPPORT=y
CONFIG_SPIRAM_MODE_OCT=y
CONFIG_SPIRAM_SPEED_80M=y
CONFIG_SPIRAM_MALLOC_ALWAYSINTERNAL=4096
CONFIG_SPIRAM_MALLOC_RESERVE_INTERNAL=8192

# Flash
CONFIG_ESPTOOLPY_FLASHMODE_QIO=y
CONFIG_ESPTOOLPY_FLASHSIZE_16MB=y

# LVGL
CONFIG_LV_COLOR_16_SWAP=y          # ST7789 字节序（esp_lvgl_port cmake 会读）
CONFIG_LV_MEM_CUSTOM=y             # 用系统 malloc，避免 LVGL 内部小堆
CONFIG_LV_FONT_MONTSERRAT_24=y     # UI 字体
CONFIG_LV_USE_PERF_MONITOR=n

# USB CDC（关键：让 esp_tinyusb 启用 CDC）
CONFIG_TINYUSB_CDC_ENABLED=y

# 自定义分区表
CONFIG_PARTITION_TABLE_CUSTOM=y

# BSP（老款 ESP32-S3-BOX）
CONFIG_BSP_LCD_DRAW_BUF_HEIGHT=10
```
